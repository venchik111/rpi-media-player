## br2-external/configs/qemu_player_defconfig
```kconfig
# --- Target: QEMU aarch64 'virt' (functional test twin of rpi4_player) ---
BR2_aarch64=y
BR2_cortex_a72=y
BR2_TOOLCHAIN_EXTERNAL=y
BR2_TOOLCHAIN_EXTERNAL_BOOTLIN=y
BR2_TOOLCHAIN_EXTERNAL_BOOTLIN_AARCH64_GLIBC_STABLE=y
BR2_GLOBAL_PATCH_DIR="board/qemu/patches"
BR2_DOWNLOAD_FORCE_CHECK_HASHES=y
BR2_CCACHE=y

# --- System ---
BR2_TARGET_GENERIC_HOSTNAME="rpi-player-qemu"
BR2_TARGET_GENERIC_ISSUE="rpi-media-player (qemu)"
BR2_ROOTFS_DEVICE_CREATION_DYNAMIC_MDEV=y
BR2_TARGET_GENERIC_ROOT_PASSWD="player"
BR2_ROOTFS_USERS_TABLES="$(BR2_EXTERNAL_RPI_PLAYER_PATH)/board/common/users.txt"
BR2_ROOTFS_OVERLAY="$(BR2_EXTERNAL_RPI_PLAYER_PATH)/board/common/rootfs-overlay $(BR2_EXTERNAL_RPI_PLAYER_PATH)/board/qemu/rootfs-overlay"
BR2_ROOTFS_POST_BUILD_SCRIPT="$(BR2_EXTERNAL_RPI_PLAYER_PATH)/board/common/post-build.sh"
BR2_ROOTFS_POST_IMAGE_SCRIPT="$(BR2_EXTERNAL_RPI_PLAYER_PATH)/board/qemu/post-image.sh"
BR2_ROOTFS_POST_SCRIPT_ARGS="qemu"
BR2_PACKAGE_BUSYBOX_CONFIG_FRAGMENT_FILES="$(BR2_EXTERNAL_RPI_PLAYER_PATH)/board/common/busybox.fragment"

# --- Kernel (upstream, Buildroot's qemu virt config + Wi-Fi simulation) ---
BR2_LINUX_KERNEL=y
BR2_LINUX_KERNEL_CUSTOM_VERSION=y
BR2_LINUX_KERNEL_CUSTOM_VERSION_VALUE="6.18.7"
BR2_LINUX_KERNEL_USE_CUSTOM_CONFIG=y
BR2_LINUX_KERNEL_CUSTOM_CONFIG_FILE="board/qemu/aarch64-virt/linux.config"
BR2_LINUX_KERNEL_CONFIG_FRAGMENT_FILES="$(BR2_EXTERNAL_RPI_PLAYER_PATH)/board/qemu/linux-wifi-sim.fragment"
BR2_LINUX_KERNEL_NEEDS_HOST_OPENSSL=y
BR2_PACKAGE_WIRELESS_REGDB=y

# --- Packages (keep in sync with qemu_player_defconfig) ---
BR2_PACKAGE_KMOD=y
BR2_PACKAGE_KMOD_TOOLS=y
BR2_PACKAGE_HOST_KMOD_XZ=y
BR2_PACKAGE_XZ=y
BR2_PACKAGE_E2FSPROGS=y
BR2_PACKAGE_OPENSSH=y
# BR2_PACKAGE_OPENSSH_CLIENT is not set
BR2_PACKAGE_OPENSSH_SERVER=y
BR2_PACKAGE_OPENSSH_KEY_UTILS=y
BR2_PACKAGE_HOSTAPD=y
BR2_PACKAGE_HOSTAPD_DRIVER_NL80211=y
BR2_PACKAGE_DNSMASQ=y
BR2_PACKAGE_IW=y
BR2_PACKAGE_LIGHTTPD=y
BR2_PACKAGE_FFMPEG=y
BR2_PACKAGE_FFMPEG_GPL=y
BR2_PACKAGE_FFMPEG_FFMPEG=y
BR2_PACKAGE_FFMPEG_FFPROBE=y
BR2_PACKAGE_FFMPEG_SWSCALE=y
# BR2_PACKAGE_FFMPEG_OUTDEVS is not set
BR2_PACKAGE_X264=y

# --- Test-only tools: Wi-Fi client in a network namespace ---
BR2_PACKAGE_IPROUTE2=y
BR2_PACKAGE_WPA_SUPPLICANT=y
BR2_PACKAGE_WPA_SUPPLICANT_NL80211=y

# --- Images ---
BR2_TARGET_ROOTFS_EXT2=y
BR2_TARGET_ROOTFS_EXT2_4=y
BR2_TARGET_ROOTFS_EXT2_LABEL="rootfs"
BR2_TARGET_ROOTFS_EXT2_SIZE="200M"
# BR2_TARGET_ROOTFS_TAR is not set
```
